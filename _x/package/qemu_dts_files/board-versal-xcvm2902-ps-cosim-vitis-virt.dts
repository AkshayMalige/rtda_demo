/* Auto-Generated via Makefile
 *
 * Copyright (c) 2024, Advanced Micro Devices, Inc
 * All rights reserved.
 *
 * SPDX-License-Identifier: BSD-3-Clause
 */
#include "board-versal-xcvm2902-ps-virt.dts"
#include "versal-ps-pl-remoteport.dtsi"
#include "versal-vitis.dtsi"
