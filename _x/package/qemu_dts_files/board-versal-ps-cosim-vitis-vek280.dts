/*
 * Vitis Versal VEK280 cosim board
 *
 * Copyright (c) 2023, Advanced Micro Devices, Inc.
 * All rights reserved.
 *
 * SPDX-License-Identifier: BSD-3-Clause
 */

#include "board-versal-ps-cosim-vitis-vek280_es_revb.dts"
